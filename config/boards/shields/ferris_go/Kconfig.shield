## config/boards/shields/ferris_go/Kconfig.shield
```kconfig
config FERRIS_GO_LEFT
    def_bool $(shields_list_contains,Ferris-go_left)

config FERRIS_GO_RIGHT
    def_bool $(shields_list_contains,Ferris-go_right)

CONFIG_ZMK_KSCAN_DIRECT_POLLING=y
```

## config/boards/shields/ferris_go/kconfig.defconfig
```kconfig
if FERRIS_GO_LEFT

config ZMK_KEYBOARD_NAME
    default "Ferris-go-L"

config ZMK_SPLIT_BLE_ROLE_CENTRAL
    default y

endif

if FERRIS_GO_RIGHT

config ZMK_KEYBOARD_NAME
    default "Ferris-go-R"

endif

if FERRIS_GO_LEFT || FERRIS_GO_RIGHT

config ZMK_SPLIT
    default y
endif
```
